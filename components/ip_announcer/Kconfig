## components/ip_announcer/Kconfig
```kconfig
menu "IP Announcer (ntfy)"

config APP_IP_ANNOUNCER_TOPIC_DEFAULT
    string "Default ntfy topic (empty = auto-generate random)"
    default ""
    help
        Topic name pushed to ntfy.sh on every IP_EVENT_STA_GOT_IP.
        WARNING: this is your channel's de-facto password — anyone
        who reads this string from your repo can subscribe and see
        every IP this device pushes. Either:
          - Leave empty: each board generates a private random topic
            on first boot. Recommended for shared / public builds.
          - Set in sdkconfig.defaults.local (gitignored): all boards
            from your private build share one topic. Convenient for
            multi-board ownership; do NOT commit this file.
        Topics that look like a placeholder ("CHANGE-ME-*", or fewer
        than 16 chars after trimming) refuse to push at runtime and
        the dashboard surfaces a red warning.

config APP_IP_ANNOUNCER_SERVER_DEFAULT
    string "Default ntfy server hostname"
    default "ntfy.sh"
    help
        Hostname only, no scheme, no path. Override at runtime via
        the dashboard / CLI for self-hosted ntfy instances.

endmenu
```

## components/psu_driver/Kconfig.projbuild
```kconfig
menu "PSU driver"

    config APP_PSU_UART_TX_GPIO
        int "PSU UART1 TX GPIO"
        default 38

    config APP_PSU_UART_RX_GPIO
        int "PSU UART1 RX GPIO"
        default 39

    choice APP_PSU_DEFAULT_FAMILY
        prompt "Default PSU family (used when NVS key absent)"
        default APP_PSU_DEFAULT_FAMILY_RIDEN
    config APP_PSU_DEFAULT_FAMILY_RIDEN
        bool "Riden RD60xx (Modbus-RTU)"
    config APP_PSU_DEFAULT_FAMILY_XY_SK120
        bool "XY-SK120 (Modbus-RTU)"
    config APP_PSU_DEFAULT_FAMILY_WZ5005
        bool "WZ5005 (custom 20-byte protocol)"
    endchoice

    # Each family's default tracks the PSU's factory-shipped baud:
    #   Riden RD60xx → 115200, XY-SK120 → 115200, WZ5005 → 19200.
    # If the bench unit's panel has been re-keyed, override per-build.
    config APP_PSU_UART_BAUD
        int "PSU UART1 baud rate (matches the PSU's panel-set rate)"
        default 115200 if APP_PSU_DEFAULT_FAMILY_RIDEN
        default 115200 if APP_PSU_DEFAULT_FAMILY_XY_SK120
        default 19200  if APP_PSU_DEFAULT_FAMILY_WZ5005

    config APP_PSU_SLAVE_DEFAULT
        int "PSU slave address default (used on first boot before NVS)"
        default 1
        range 1 255

endmenu
```

## main/Kconfig.projbuild
```kconfig
menu "Fan-TestKit App"

    config APP_PWM_OUTPUT_GPIO
        int "PWM output GPIO"
        default 4

    config APP_PWM_TRIGGER_GPIO
        int "PWM change-trigger output GPIO"
        default 5

    config APP_RPM_INPUT_GPIO
        int "RPM capture input GPIO"
        default 6

    config APP_STATUS_LED_GPIO
        int "Onboard status RGB LED GPIO (WS2812)"
        default 48

    config APP_DEFAULT_RPM_TIMEOUT_US
        int "Default RPM timeout in microseconds (edge→0 RPM)"
        default 1000000

    config APP_DEFAULT_POLE_COUNT
        int "Default motor pole count"
        default 2

    config APP_DEFAULT_MAVG_COUNT
        int "Default RPM moving-average count"
        default 1

    config APP_POWER_SWITCH_GPIO
        int "Power-switch GPIO"
        default 21

    config APP_POWER_SWITCH_ACTIVE_LOW
        bool "Power-switch is active-low (low-trigger relay module)"
        default y

    config APP_GPIO_GROUP_A_PIN_0
        int "Group A pin 0 GPIO"
        default 7
    config APP_GPIO_GROUP_A_PIN_1
        int "Group A pin 1 GPIO"
        default 15
    config APP_GPIO_GROUP_A_PIN_2
        int "Group A pin 2 GPIO"
        default 16
    config APP_GPIO_GROUP_A_PIN_3
        int "Group A pin 3 GPIO"
        default 17
    config APP_GPIO_GROUP_A_PIN_4
        int "Group A pin 4 GPIO"
        default 18
    config APP_GPIO_GROUP_A_PIN_5
        int "Group A pin 5 GPIO"
        default 8
    config APP_GPIO_GROUP_A_PIN_6
        int "Group A pin 6 GPIO"
        default 9
    config APP_GPIO_GROUP_A_PIN_7
        int "Group A pin 7 GPIO"
        default 10

    config APP_GPIO_GROUP_B_PIN_0
        int "Group B pin 0 GPIO"
        default 11
    config APP_GPIO_GROUP_B_PIN_1
        int "Group B pin 1 GPIO"
        default 12
    config APP_GPIO_GROUP_B_PIN_2
        int "Group B pin 2 GPIO"
        default 13
    config APP_GPIO_GROUP_B_PIN_3
        int "Group B pin 3 GPIO"
        default 14
    config APP_GPIO_GROUP_B_PIN_4
        int "Group B pin 4 GPIO"
        default 1
    config APP_GPIO_GROUP_B_PIN_5
        int "Group B pin 5 GPIO"
        default 2
    config APP_GPIO_GROUP_B_PIN_6
        int "Group B pin 6 GPIO"
        default 42
    config APP_GPIO_GROUP_B_PIN_7
        int "Group B pin 7 GPIO"
        default 41

    config APP_DEFAULT_PULSE_WIDTH_MS
        int "Default GPIO pulse width (ms) on first boot before NVS is set"
        default 100
        range 1 10000

endmenu
```

## sdkconfig.defaults
```kconfig
# Target
CONFIG_IDF_TARGET="esp32s3"

# Flash + PSRAM (N16R8 module)
CONFIG_ESPTOOLPY_FLASHSIZE_16MB=y
CONFIG_ESPTOOLPY_FLASHSIZE="16MB"
CONFIG_SPIRAM=y
CONFIG_SPIRAM_MODE_OCT=y
CONFIG_SPIRAM_SPEED_80M=y
CONFIG_SPIRAM_USE_MALLOC=y

# Partition table
# Secure Boot V2 + Flash Encryption grows the signed bootloader past the
# default 0x8000 limit, so push the partition table offset to 0xE000
# (56 KB of bootloader room, comfortable for v5.5 Secure Boot V2 + ~40 KB).
# CONFIG_PARTITION_TABLE_TYPE is a choice; we must explicitly unset the
# other members to override a previously-generated sdkconfig.
CONFIG_PARTITION_TABLE_CUSTOM=y
CONFIG_PARTITION_TABLE_SINGLE_APP=n
CONFIG_PARTITION_TABLE_SINGLE_APP_LARGE=n
CONFIG_PARTITION_TABLE_TWO_OTA=n
CONFIG_PARTITION_TABLE_TWO_OTA_LARGE=n
CONFIG_PARTITION_TABLE_CUSTOM_FILENAME="partitions.csv"
CONFIG_PARTITION_TABLE_OFFSET=0xE000

# FreeRTOS
CONFIG_FREERTOS_HZ=1000
CONFIG_FREERTOS_UNICORE=n

# Logging (UART0 console via USB1 / CH343P)
CONFIG_LOG_DEFAULT_LEVEL_INFO=y
# CONFIG_LOG_MAXIMUM_LEVEL is a choice group — list all members explicitly so
# this override survives a stale sdkconfig (CLAUDE.md sdkconfig trap).
#
# **Workaround for v6.0 MCPWM band-cross bug**: with the choice at default
# (LOG_MAXIMUM_EQUALS_DEFAULT, max=INFO), `pwm_gen` produces a 16× too-high
# output frequency on the FIRST cross from HI band → LO band (e.g. asking
# for 100 Hz outputs 1.6 kHz). Bumping max to DEBUG and the runtime
# `esp_log_level_set("mcpwm", ESP_LOG_DEBUG)` in pwm_gen_init() together
# make the bug disappear, even though neither call should have hardware
# effect. Suspected cause: extra microseconds inside the driver's LOGD
# argument formatting let some MCPWM register write settle before the next
# read, but root cause is not isolated. Removing this Kconfig OR removing
# the esp_log_level_set call brings the bug back. Cost: ~few KB of LOGD
# format strings linked in. See HANDOFF.md "Open issues" for follow-up.
CONFIG_LOG_MAXIMUM_EQUALS_DEFAULT=n
CONFIG_LOG_MAXIMUM_LEVEL_DEBUG=y
CONFIG_LOG_MAXIMUM_LEVEL_VERBOSE=n

# Compiler
CONFIG_COMPILER_OPTIMIZATION_PERF=y
CONFIG_COMPILER_WARN_WRITE_STRINGS=y

# OTA / Secure Boot / Flash Encryption
# 第一次 bring-up 暫時關掉 Secure Boot V2 + Flash Encryption。一旦
# firmware 驗證可以 boot、跑得起來，再依 docs/release-hardening.md
# 逐步把 security features 打開。**注意：** 現階段這顆 chip 的 eFuse
# 尚未被燒寫（boot loop 發生在 secure-boot digest burn 之前），所以
# 改回 n 是 safe 的；一旦 Secure Boot 或 Flash Enc 曾經成功 boot 過
# 一次，eFuse 就無法回頭，不能再套用 Plan A。
CONFIG_BOOTLOADER_APP_ROLLBACK_ENABLE=y
CONFIG_BOOTLOADER_APP_ANTI_ROLLBACK=n

CONFIG_SECURE_BOOT=n
CONFIG_SECURE_FLASH_ENC_ENABLED=n

# HTTPD / WebSocket
CONFIG_HTTPD_WS_SUPPORT=y
CONFIG_HTTPD_MAX_REQ_HDR_LEN=1024
CONFIG_HTTPD_MAX_URI_LEN=512

# TinyUSB (composite: HID + CDC) — esp_tinyusb 1.7.x Kconfig options.
CONFIG_TINYUSB_HID_COUNT=1
CONFIG_TINYUSB_CDC_ENABLED=y
CONFIG_TINYUSB_CDC_COUNT=1

# mDNS service for dashboard discovery (`esp32-pwm.local`). Default
# MAX_SERVICES=10 is fine, but we pin it explicitly so cleaning
# sdkconfig doesn't silently drop below 1.
CONFIG_MDNS_MAX_SERVICES=4

# Power
CONFIG_ESP_DEFAULT_CPU_FREQ_MHZ_240=y
```
